## Kconfig
```kconfig
# Copyright (c) 2026 Realtek Semiconductor Corp.
# SPDX-License-Identifier: Apache-2.0

rsource "input/Kconfig"
rsource "output/display/Kconfig"
```

## input/Kconfig
```kconfig
# Copyright (c) 2026 Realtek Semiconductor Corp.
# SPDX-License-Identifier: Apache-2.0

menu "Realtek Input Devices"

rsource "touch/Kconfig"

config REALTEK_KEY_BUTTON
	bool "Enable Realtek Key/Button Device"
	default n
	help
		This config for realtek Key/Button device driver

config REALTEK_KEY_BUTTON_8773G
	bool "Enable Realtek Key/Button Device (RTL8773G)"
	select REALTEK_KEY_BUTTON
	default n
	help
		This config for realtek Key/Button device driver

config REALTEK_KEY_BUTTON_8773G_ZEPHYR
	bool "Enable Realtek Key/Button Device (RTL8773G, Zephyr code style)"
	select REALTEK_KEY_BUTTON
	select GPIO
	select GPIO_ENABLE_DISABLE_INTERRUPT
	default n
	help
		This config for realtek Key/Button device driver.
		The Zephyr-style driver uses gpio_pin_interrupt_configure_dt() with
		GPIO_INT_MODE_ENABLE_ONLY/DISABLE_ONLY which require
		CONFIG_GPIO_ENABLE_DISABLE_INTERRUPT (whose own dependency on
		CONFIG_GPIO must also be satisfied).

config REALTEK_KEY_BUTTON_8773E
	bool "Enable Realtek Key/Button Device (RTL8773E)"
	select REALTEK_KEY_BUTTON
	default n
	help
		This config for realtek Key/Button device driver

config REALTEK_KEY_BUTTON_8772F
	bool "Enable Realtek Key/Button Device (RTL8772F)"
	select REALTEK_KEY_BUTTON
	default n
	help
		This config for realtek Key/Button device driver

endmenu
```

## input/touch/Kconfig
```kconfig
# Copyright (c) 2026 Realtek Semiconductor Corp.
# SPDX-License-Identifier: Apache-2.0

config REALTEK_TOUCH
    bool "Enable Realtek touch core"
    default y if REALTEK_HONEYGUI
    help
        Platform-independent touch data and default-device registration API.
        This can be enabled without any display or touch controller.
        Without a registered device the API returns released/zero data.
        HoneyGUI enables the core by default to retain its no-touch fallback.

menu "Legacy touch controllers"

config REALTEK_TOUCH_CHSC6417
    bool "Enable legacy Realtek touch CHSC6417"
    select REALTEK_TOUCH
    default n

config REALTEK_TOUCH_CHSC6413
    bool "Enable legacy Realtek touch CHSC6413"
    select REALTEK_TOUCH
    default n

config REALTEK_TOUCH_GT911
    bool "Enable legacy Realtek touch GT911"
    select REALTEK_TOUCH
    default n

config REALTEK_TOUCH_CST816D
    bool "Enable legacy Realtek touch CST816D"
    select REALTEK_TOUCH
    default n

config REALTEK_TOUCH_CST820
    bool "Enable legacy Realtek touch CST820"
    select REALTEK_TOUCH
    default n

endmenu

config REALTEK_INPUT_INIT_PRIORITY
    int "Realtek input device initialization priority"
    range 51 99
    default 60
    help
        POST_KERNEL initialization priority for input drivers using this setting.
        Keep it after the board's GPIO and I2C initialization priorities.

choice REALTEK_TOUCH_ZEPHYR_CONTROLLER
    prompt "Zephyr touch controller"
    optional
    help
        Select at most one controller: the compatibility raw-data API and
        default-device binding currently support one controller per build.

config REALTEK_TOUCH_CHSC6417_ZEPHYR
    bool "CHSC6417"
    select REALTEK_TOUCH
    select I2C
    select GPIO

config REALTEK_TOUCH_CHSC6413_ZEPHYR
    bool "CHSC6413"
    select REALTEK_TOUCH
    select I2C
    select GPIO

config REALTEK_TOUCH_CST816D_ZEPHYR
    bool "CST816D"
    select REALTEK_TOUCH
    select I2C
    select GPIO

config REALTEK_TOUCH_CST820_ZEPHYR
    bool "CST820"
    select REALTEK_TOUCH
    select I2C
    select GPIO

endchoice
```

## output/display/Kconfig
```kconfig
# Copyright (c) 2026 Realtek Semiconductor Corp.
# SPDX-License-Identifier: Apache-2.0

config REALTEK_DISPLAY_LCDC_SHARED
    bool "Use shared 8762G/8773E/8773G LCDC device controllers"
    depends on REALTEK_DISPLAY
    depends on SOC_SERIES_RTL87X2G || SOC_SERIES_RTL8773E || SOC_SERIES_RTL87X3E || SOC_SERIES_RTL87X3G || SOC_SERIES_RTL8773G
    default y if SOC_SERIES_RTL87X3G || SOC_SERIES_RTL8773G
    select REALTEK_DISPLAY_ENABLE_LCDC
    help
        Share SDI/DBIC and RGB/eDPI device logic, with SoC clock, Pad and IRQ
        ports. 8773E and 8762G must supply their real SDK/HAL and board bus
        data. No new board definitions are supplied by this option.
        This replaces legacy LCD device sources on the selected SoC; legacy
        touch/key drivers remain available. 8773G retains its existing default.
        Supported bus clocks: 8773G 200/280 MHz, 8773E 200 MHz, 8762G 100 MHz.
```
